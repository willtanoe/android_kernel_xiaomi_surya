## scripts/tests/fixtures/resolved-defconfig/ksu.defconfig
```kconfig
CONFIG_KSU=y
CONFIG_KSU_TAMPER_SYSCALL_TABLE=y
# CONFIG_KSU_DEBUG is not set
# CONFIG_KSU_THRONE_TRACKER_ALWAYS_THREADED is not set
CONFIG_KSU_LSM_SECURITY_HOOKS=y
CONFIG_REQUIRED=y
```

## scripts/tests/fixtures/resolved-defconfig/types.defconfig
```kconfig
CONFIG_ENABLED=y
# CONFIG_DISABLED is not set
CONFIG_MODULE=m
CONFIG_LABEL="Avalanche"
CONFIG_WORD="y"
CONFIG_COUNT=128
CONFIG_MASK=0x20
```
